## drivers/adc/Kconfig.ad594x
```kconfig
# Copyright (c) 2023 Grinn
# SPDX -License-Identifier: Apache-2.0

config ADC_AD594X
	bool "AD594X ADC driver"
	default y
	depends on DT_HAS_ADI_AD594X_ADC_ENABLED
	select MFD
	help
	  Enable the AD594X ADC driver.

config ADC_AD594X_ACQUISITION_THREAD_STACK_SIZE
	int "Stack size for the ADC data acquisition thread"
	depends on ADC_AD594X
	default 384
	help
	  Size of the stack used for the internal data acquisition
	  thread.

config ADC_AAD594X_ACQUISITION_THREAD_PRIO
	int "Priority for the ADC data acquisition thread"
	depends on ADC_AD594X
	default 0
	help
	  Priority level for the internal ADC data acquisition thread.
```
